#include <dt-bindings/zmk/matrix_transform.h>
#include "bault-transforms.dtsi"
#include "bault-layouts.dtsi"

/ {
    chosen {
        zmk,kscan = &mock_kscan;
    };

    mock_kscan: mock_kscan_0 {
        compatible = "zmk,kscan-mock";
        columns = <11>;
        rows = <4>;
        events = <0>;
    };
};